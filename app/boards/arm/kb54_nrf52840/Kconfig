## app/boards/arm/kb54_nrf52840/Kconfig
```kconfig
if BOARD_KB54_NRF52840_L || BOARD_KB54_NRF52840_R

config BOARD_ENABLE_DCDC
    bool "DCDC mode"
    select SOC_DCDC_NRF52X
    default y

endif # BOARD_KB54_NRF52840_L || BOARD_KB54_NRF52840_R
```

## app/boards/arm/kb54_nrf52840/Kconfig.board
```kconfig
config BOARD_KB54_NRF52840_L
    bool "KB54 L"
    depends on SOC_NRF52840_QIAA

config BOARD_KB54_NRF52840_R
    bool "KB54 R"
    depends on SOC_NRF52840_QIAA
```

## app/boards/arm/kb54_nrf52840/Kconfig.defconfig
```kconfig
if BOARD_KB54_NRF52840_L

config BOARD
    default "kb54_nrf52840_l"

config ZMK_SPLIT_BLE_ROLE_CENTRAL
    default y

endif # BOARD_KB54_NRF52840_L



if BOARD_KB54_NRF52840_R

config BOARD
    default "kb54_nrf52840_r"

endif # BOARD_KB54_NRF52840_R



if BOARD_KB54_NRF52840_L || BOARD_KB54_NRF52840_R

config ZMK_SPLIT
    default y

config BT_CTLR
    default BT

config ZMK_KSCAN_MATRIX_WAIT_BETWEEN_OUTPUTS
    default 5

config PINCTRL
    default y

if USB

config USB_NRFX
    default y

config USB_DEVICE_STACK
    default y

endif # USB

endif # BOARD_KB54_NRF52840_L || BOARD_KB54_NRF52840_R
```

## app/boards/arm/kb54_nrf52840/kb54_nrf52840_r_defconfig
```kconfig
CONFIG_SOC_SERIES_NRF52X=y
CONFIG_SOC_NRF52840_QIAA=y
CONFIG_BOARD_KB54_NRF52840_R=y

# Enable both USB and BLE
CONFIG_ZMK_BLE=y

# Keyboard IDs
CONFIG_ZMK_KEYBOARD_NAME="KB54 Right"

# BLE TX Power
CONFIG_BT_CTLR_TX_PWR_PLUS_8=y

# Enable MPU
CONFIG_ARM_MPU=y

# Enable GPIO
CONFIG_GPIO=y

# Flash configuration
CONFIG_SETTINGS=y
CONFIG_MPU_ALLOW_FLASH_WRITE=y
CONFIG_NVS=y
CONFIG_SETTINGS_NVS=y
CONFIG_FLASH=y
CONFIG_FLASH_PAGE_LAYOUT=y
CONFIG_FLASH_MAP=y

# Enable 32kHz crystal
CONFIG_CLOCK_CONTROL_NRF_K32SRC_XTAL=y

CONFIG_ZMK_USB_LOGGING=n
CONFIG_ZMK_RTT_LOGGING=n
```
